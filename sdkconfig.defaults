## sdkconfig.defaults
```kconfig
CONFIG_PARTITION_TABLE_CUSTOM=y
CONFIG_PARTITION_TABLE_CUSTOM_FILENAME="partitions_hap.csv"
CONFIG_PARTITION_TABLE_CUSTOM_APP_BIN_OFFSET=0x10000
CONFIG_FREERTOS_UNICORE=y
CONFIG_FREERTOS_ASSERT_ON_UNTESTED_FUNCTION=n
CONFIG_FREERTOS_ASSERT_FAIL_ABORT=n
CONFIG_FREERTOS_ASSERT_DISABLE=y
CONFIG_LWIP_MAX_SOCKETS=16
CONFIG_LWIP_SO_REUSE=y
CONFIG_LWIP_MAX_ACTIVE_TCP=12
CONFIG_LWIP_MAX_LISTENING_TCP=12
CONFIG_LWIP_UDP_RECVMBOX_SIZE=10
CONFIG_MBEDTLS_HARDWARE_MPI=y
CONFIG_MBEDTLS_HARDWARE_SHA=n
CONFIG_ESP_TASK_WDT=n
CONFIG_LWIP_AUTOIP=y
CONFIG_ESPTOOLPY_FLASHSIZE_4MB=y
CONFIG_LWIP_AUTOIP_RATE_LIMIT_INTERVAL=60
CONFIG_MP_BLOB_SUPPORT=y
CONFIG_ENABLE_UNIFIED_PROVISIONING=y
# HTTPS OTA: trust standard CAs (incl. GitHub) via the bundled cert store
CONFIG_MBEDTLS_CERTIFICATE_BUNDLE=y
CONFIG_MBEDTLS_CERTIFICATE_BUNDLE_DEFAULT_CMN=y
# OTA rollback: auto-revert if a new image never confirms a healthy boot
CONFIG_BOOTLOADER_APP_ROLLBACK_ENABLE=y
# Optimize for size to keep the image within the 1600K OTA slot
CONFIG_COMPILER_OPTIMIZATION_SIZE=y
```
