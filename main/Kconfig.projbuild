## main/Kconfig.projbuild
```kconfig
menu "Example Configuration"

    config EXAMPLE_USE_HARDCODED_SETUP_CODE
        bool "Use hard-coded setup code"
        default y
        help
            HomeKit does not recommend having the setup code programmed in the accessory as is.
            Instead, it expects setup info (salt-verifier pair) generated for the given setup code.
            Use this option only for testing purposes. For production, the setup info should be
            used.

    config EXAMPLE_SETUP_CODE
        string "HomeKit Setup Code"
        default "111-22-333"
        depends on EXAMPLE_USE_HARDCODED_SETUP_CODE
        help
            Setup code to be used for HomeKot pairing, if hard-coded setup code is enabled.

    config EXAMPLE_SETUP_ID
        string "HomeKit Setup Id"
        default "ES32"
        depends on EXAMPLE_USE_HARDCODED_SETUP_CODE
        help
            Setup id to be used for HomeKot pairing, if hard-coded setup code is enabled.

    config OTA_POLL_INTERVAL_SEC
        int "OTA poll interval (seconds)"
        default 3600
        help
            How often the device checks GitHub Releases for a newer firmware.

    config OTA_GITHUB_BASE_URL
        string "GitHub repo base URL for OTA"
        default "https://github.com/larsakeekstrand/ESP32-homekit-garage-opener"
        help
            Base URL of the GitHub repo. The updater fetches
            <base>/releases/latest/download/version.txt and .../garage.bin


    config AUTO_CLOSE_DEFAULT_SEC
        int "Auto-close timeout default (seconds, 0 = disabled)"
        default 600
        help
            Seed value for the auto-close timeout on a fresh device. Runtime
            changes are stored in NVS and take precedence.

    config LEFT_OPEN_DEFAULT_SEC
        int "Door-left-open alert default (seconds, 0 = disabled)"
        default 300
        help
            Seed value for the left-open alert threshold on a fresh device.
            Runtime changes are stored in NVS and take precedence.

endmenu
```
